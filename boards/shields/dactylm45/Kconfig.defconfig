## boards/shields/dactylm45/Kconfig.defconfig
```kconfig
if SHIELD_DACTYLM45_LEFT

config ZMK_KEYBOARD_NAME
    default "DactylM45"

config ZMK_SPLIT_ROLE_CENTRAL
    default y

endif

if SHIELD_DACTYLM45_LEFT || SHIELD_DACTYLM45_RIGHT

config ZMK_SPLIT
    default y

endif
```

## boards/shields/dactylm45/Kconfig.shield
```kconfig
# Copyright (c) 2020 Pete Johanson
# SPDX-License-Identifier: MIT

config SHIELD_DACTYLM45
    bool

config SHIELD_DACTYLM45_LEFT
    def_bool $(shields_list_contains,dactylm45_left)
    select SHIELD_DACTYLM45

config SHIELD_DACTYLM45_RIGHT
    def_bool $(shields_list_contains,dactylm45_right)
    select SHIELD_DACTYLM45

config SHIELD_DACTYLM45_REV2_LEFT
    def_bool $(shields_list_contains,dactylm45_rev2_left)
    select SHIELD_DACTYLM45

config SHIELD_DACTYLM45_REV2_RIGHT
    def_bool $(shields_list_contains,dactylm45_rev2_right)
    select SHIELD_DACTYLM45

config SHIELD_DACTYLM45_REV3_LEFT
    def_bool $(shields_list_contains,dactylm45_rev3_left)
    select SHIELD_DACTYLM45

config SHIELD_DACTYLM45_REV3_RIGHT
    def_bool $(shields_list_contains,dactylm45_rev3_right)
    select SHIELD_DACTYLM45
```

## config/boards/shields/dactylm45/Kconfig.defconfig
```kconfig
if SHIELD_DACTYLM45_LEFT

config ZMK_KEYBOARD_NAME
  default "dactylm45_left"

endif

if SHIELD_DACTYLM45_RIGHT

config ZMK_KEYBOARD_NAME
  default "dactylm45_right"

config ZMK_SPLIT_BLE_ROLE_CENTRAL
 default y

endif

if SHIELD_DACTYLM45_LEFT || SHIELD_DACTYLM45_RIGHT

config ZMK_SPLIT
  default y

endif
```

## config/boards/shields/dactylm45/Kconfig.shield
```kconfig
# Copyright (c) 2020 Pete Johanson
# SPDX-License-Identifier: MIT

config SHIELD_DACTYLM45_LEFT
  def_bool $(shields_list_contains,dactylm45_left)

config SHIELD_DACTYLM45_RIGHT
  def_bool $(shields_list_contains,dactylm45_right)
```
